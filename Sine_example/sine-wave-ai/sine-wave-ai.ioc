# file: sine-wave-ai.ioc
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Mcu.Family=STM32F3
Mcu.Name=STM32F334C(4-6-8)Tx
Mcu.Package=LQFP48
NVIC.PriorityGroup=NVIC_PRIORITYGROUP_4
ProjectManager.HeapSize=0x800
ProjectManager.StackSize=0x800
ProjectManager.TargetToolchain=STM32CubeIDE
RCC.AHBFreq_Value=64000000
RCC.APB1CLKDivider=RCC_HCLK_DIV2
RCC.APB1Freq_Value=32000000
RCC.APB1TimFreq_Value=64000000
RCC.APB2Freq_Value=64000000
RCC.APB2TimFreq_Value=64000000
RCC.CortexFreq_Value=64000000
RCC.HCLKFreq_Value=64000000
RCC.HSE_VALUE=8000000
RCC.HSI_VALUE=8000000
RCC.LSE_VALUE=32768
RCC.PLLMUL=RCC_PLL_MUL16
RCC.SYSCLKFreq_VALUE=64000000
RCC.SYSCLKSourceVirtual=RCC_SYSCLKSOURCE_PLLCLK
STMicroelectronics.X-CUBE-AI.10.0.0.ActivationBufferSizeList=1940
STMicroelectronics.X-CUBE-AI.10.0.0.ActivationBuffers=pool0
STMicroelectronics.X-CUBE-AI.10.0.0.ActivationNames=pool0
STMicroelectronics.X-CUBE-AI.10.0.0.ActivationSizes=AI_SIN_WAVE_DATA_ACTIVATION_1_SIZE
STMicroelectronics.X-CUBE-AI.10.0.0.HeapSize=0x800
STMicroelectronics.X-CUBE-AI.10.0.0.InternalRamActivationBufferMaxSize=AI_SIN_WAVE_DATA_ACTIVATIONS_SIZE
STMicroelectronics.X-CUBE-AI.10.0.0.LatestDirectoryUsed-e656aba7ebc5077a3f43da13a0005316c22daf62293d0a39c843a26915dc752b=C\:\\Users\\igor4\\trash\\Downloads
STMicroelectronics.X-CUBE-AI.10.0.0.MaximumNumberOfInputLayer=1
STMicroelectronics.X-CUBE-AI.10.0.0.MaximumNumberOfOutputLayer=1
STMicroelectronics.X-CUBE-AI.10.0.0.MaximumSizeOfInputLayer=1
STMicroelectronics.X-CUBE-AI.10.0.0.MaximumSizeOfOutputLayer=1
STMicroelectronics.X-CUBE-AI.10.0.0.ModelActualCompression-e656aba7ebc5077a3f43da13a0005316c22daf62293d0a39c843a26915dc752b=0.0
STMicroelectronics.X-CUBE-AI.10.0.0.ModelCompression-e656aba7ebc5077a3f43da13a0005316c22daf62293d0a39c843a26915dc752b=Medium
STMicroelectronics.X-CUBE-AI.10.0.0.ModelFlashOccupation-e656aba7ebc5077a3f43da13a0005316c22daf62293d0a39c843a26915dc752b=9302
STMicroelectronics.X-CUBE-AI.10.0.0.ModelHashList=e656aba7ebc5077a3f43da13a0005316c22daf62293d0a39c843a26915dc752b
STMicroelectronics.X-CUBE-AI.10.0.0.ModelKind-e656aba7ebc5077a3f43da13a0005316c22daf62293d0a39c843a26915dc752b=TFLITE
STMicroelectronics.X-CUBE-AI.10.0.0.ModelMacc-e656aba7ebc5077a3f43da13a0005316c22daf62293d0a39c843a26915dc752b=353
STMicroelectronics.X-CUBE-AI.10.0.0.ModelName-e656aba7ebc5077a3f43da13a0005316c22daf62293d0a39c843a26915dc752b=sin_wave
STMicroelectronics.X-CUBE-AI.10.0.0.ModelNameList=sin_wave
STMicroelectronics.X-CUBE-AI.10.0.0.ModelRamOccupation-e656aba7ebc5077a3f43da13a0005316c22daf62293d0a39c843a26915dc752b=1940
STMicroelectronics.X-CUBE-AI.10.0.0.ModelStructureFile-e656aba7ebc5077a3f43da13a0005316c22daf62293d0a39c843a26915dc752b=C\:\\Users\\igor4\\trash\\Downloads\\sine_model.tflite
STMicroelectronics.X-CUBE-AI.10.0.0.ModelType-e656aba7ebc5077a3f43da13a0005316c22daf62293d0a39c843a26915dc752b=STM32Cube.AI MCU runtime
STMicroelectronics.X-CUBE-AI.10.0.0.ReadyForCodeGeneration=true
STMicroelectronics.X-CUBE-AI.10.0.0.StackSize=0x800
STMicroelectronics.X-CUBE-AI.10.0.0.WorkingBufferStartAddrList=0xFFFFFFFF
STMicroelectronics.X-CUBE-AI.10.0.0.XAaCUBEAaAICcArtificialOoIntelligenceJjCore=true
STMicroelectronics.X-CUBE-AI.10.0.0.copyWeightToRam=false
STMicroelectronics.X-CUBE-AI.10.0.0.copyWeightToRam-e656aba7ebc5077a3f43da13a0005316c22daf62293d0a39c843a26915dc752b=false
STMicroelectronics.X-CUBE-AI.10.0.0.customLayerConfigEnabled=false
STMicroelectronics.X-CUBE-AI.10.0.0.customLayerConfigEnabled-e656aba7ebc5077a3f43da13a0005316c22daf62293d0a39c843a26915dc752b=false
STMicroelectronics.X-CUBE-AI.10.0.0.noOnnxIoTranspose=false
STMicroelectronics.X-CUBE-AI.10.0.0.noOnnxIoTranspose-e656aba7ebc5077a3f43da13a0005316c22daf62293d0a39c843a26915dc752b=false
STMicroelectronics.X-CUBE-AI.10.0.0.useInputAllocation=true
STMicroelectronics.X-CUBE-AI.10.0.0.useInputAllocation-e656aba7ebc5077a3f43da13a0005316c22daf62293d0a39c843a26915dc752b=true
STMicroelectronics.X-CUBE-AI.10.0.0.useOutputAllocation=true
STMicroelectronics.X-CUBE-AI.10.0.0.useOutputAllocation-e656aba7ebc5077a3f43da13a0005316c22daf62293d0a39c843a26915dc752b=true
VP_STMicroelectronics.X-CUBE-AI_VS_ArtificialOoIntelligenceJjXAaCUBEAaAI_10.0.0.Mode=ArtificialOoIntelligenceJjXAaCUBEAaAI
board=custom

// file: Core/Src/main.c
/* USER CODE BEGIN Header */
/**
  ******************************************************************************
  * @file           : main.c
  * @brief          : Main program body
  ******************************************************************************
  * @attention
  *
  * Copyright (c) 2025 STMicroelectronics.
  * All rights reserved.
  *
  * This software is licensed under terms that can be found in the LICENSE file
  * in the root directory of this software component.
  * If no LICENSE file comes with this software, it is provided AS-IS.
  *
  ******************************************************************************
  */
/* USER CODE END Header */
#include "main.h"

/* USER CODE BEGIN Includes */
#include "ai_platform.h"
#include "ai_datatypes_defines.h"

#include "sin_wave.h"
#include "sin_wave_data.h"
/* USER CODE END Includes */

/* USER CODE BEGIN PV */

/* @brief Statically allocated buffers.
 * Buffers can be dynamically allocated using malloc and size information
 * given by the report in ai_network_get_report().
 */
ai_u8 activations[AI_SIN_WAVE_DATA_ACTIVATIONS_SIZE];
ai_u8 in_data[AI_SIN_WAVE_IN_1_SIZE_BYTES];
ai_u8 out_data[AI_SIN_WAVE_OUT_1_SIZE_BYTES];

char TX_Buffer[128] = {0,};
int StrLen = 0;

/* AI buffer IO handlers */
ai_buffer *ai_input;
ai_buffer *ai_output;

float x_val = 2.0f;
float y_val = 0.0f;

/* USER CODE END PV */

void SystemClock_Config(void);

int main(void)
{

  /* MCU Configuration--------------------------------------------------------*/

  /* Reset of all peripherals, Initializes the Flash interface and the Systick. */
  HAL_Init();

  /* Configure the system clock */
  SystemClock_Config();

  /* Initialize all configured peripherals */
  /* USER CODE BEGIN 2 */
  ai_handle network = AI_HANDLE_NULL;
  	ai_error err;
  	ai_network_report report;

	/** @brief Initialize network */
	const ai_handle acts[] = { activations };
	err = ai_sin_wave_create_and_init(&network, acts, NULL);
	if (err.type != AI_ERROR_NONE)
	{
		return -1;
	}

	/** @brief {optional} for debug/log purpose */
	if (ai_sin_wave_get_report(network, &report) != true)
	{
		return -1;
	}

	ai_input = &report.inputs[0];
	ai_output = &report.outputs[0];
	/** @brief Fill input buffer with random values */
	for (uint32_t i = 0; i < AI_SIN_WAVE_IN_1_SIZE; i++)
	{
		((ai_float*) in_data)[i] = (ai_float) x_val;
	}

	/** @brief Normalize, convert and/or quantize inputs if necessary... */

	/** @brief Perform inference */
	ai_i32 n_batch;

	/** @brief Create the AI buffer IO handlers
	 *  @note  ai_inuput/ai_output are already initilaized after the
	 *         ai_network_get_report() call. This is just here to illustrate
	 *         the case where get_report() is not called.
	 */
	ai_input = ai_sin_wave_inputs_get(network, NULL);
	ai_output = ai_sin_wave_outputs_get(network, NULL);

	/** @brief Set input/output buffer addresses */
	ai_input[0].data = AI_HANDLE_PTR(in_data);
	ai_output[0].data = AI_HANDLE_PTR(out_data);

  /* USER CODE END 2 */

  /* Infinite loop */
  while (1)
  {

    /* USER CODE BEGIN 3 */
	  for (uint32_t i = 0; i < AI_SIN_WAVE_IN_1_SIZE; i++)
	  		{
	  			((ai_float*) in_data)[i] = (ai_float) x_val;
	  		}

	  		/** @brief Perform the inference */
	  		n_batch = ai_sin_wave_run(network, &ai_input[0], &ai_output[0]);
	  		if (n_batch != 1)
	  		{
	  			err = ai_sin_wave_get_error(network);
	  			return -1;
	  		}

	  		/** @brief Post-process the output results/predictions */
	  		y_val = ((float*) out_data)[0];

	  		if (x_val > 6.0f)
	  		{
	  			x_val = 0.0f;
	  		}
	  		else
	  		{
	  			x_val = x_val + 0.1f;
	  		}

	  		HAL_Delay(500);

  }
  /* USER CODE END 3 */
}

void SystemClock_Config(void)
{
  RCC_OscInitTypeDef RCC_OscInitStruct = {0};
  RCC_ClkInitTypeDef RCC_ClkInitStruct = {0};

  /** Initializes the RCC Oscillators according to the specified parameters
  * in the RCC_OscInitTypeDef structure.
  */
  RCC_OscInitStruct.OscillatorType = RCC_OSCILLATORTYPE_HSI;
  RCC_OscInitStruct.HSIState = RCC_HSI_ON;
  RCC_OscInitStruct.HSICalibrationValue = RCC_HSICALIBRATION_DEFAULT;
  RCC_OscInitStruct.PLL.PLLState = RCC_PLL_ON;
  RCC_OscInitStruct.PLL.PLLSource = RCC_PLLSOURCE_HSI;
  RCC_OscInitStruct.PLL.PLLMUL = RCC_PLL_MUL16;
  if (HAL_RCC_OscConfig(&RCC_OscInitStruct) != HAL_OK)
  {
    Error_Handler();
  }

  /** Initializes the CPU, AHB and APB buses clocks
  */
  RCC_ClkInitStruct.ClockType = RCC_CLOCKTYPE_HCLK|RCC_CLOCKTYPE_SYSCLK
                              |RCC_CLOCKTYPE_PCLK1|RCC_CLOCKTYPE_PCLK2;
  RCC_ClkInitStruct.SYSCLKSource = RCC_SYSCLKSOURCE_PLLCLK;
  RCC_ClkInitStruct.AHBCLKDivider = RCC_SYSCLK_DIV1;
  RCC_ClkInitStruct.APB1CLKDivider = RCC_HCLK_DIV2;
  RCC_ClkInitStruct.APB2CLKDivider = RCC_HCLK_DIV1;

  if (HAL_RCC_ClockConfig(&RCC_ClkInitStruct, FLASH_LATENCY_2) != HAL_OK)
  {
    Error_Handler();
  }
}

void Error_Handler(void)
{
  __disable_irq();
  while (1)
  {
  }
}
